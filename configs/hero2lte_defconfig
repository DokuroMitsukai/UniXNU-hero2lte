## configs/hero2lte_defconfig
```kconfig
CONFIG_XNU_ARM_DT_PLATFORM=y
CONFIG_XNU_ARMCPU=y
CONFIG_XNU_CRYPTO_BOOTSTRAP="prelinked"
# CONFIG_XNU_NATIVE_UFS is not set
# CONFIG_XNU_NATIVE_ADRENO is not set
```
